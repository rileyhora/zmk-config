## config/west.yml
```yaml
manifest:
  remotes:
    # ZMK official
    - name: zmkfirmware
      url-base: https://github.com/zmkfirmware
    # Your own repo
    - name: rileyhora
      url-base: https://github.com/rileyhora

  projects:
    - name: zmk
      remote: zmkfirmware
      revision: main
      import: app/west.yml

  self:
    path: config
```
